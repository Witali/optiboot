/* Hardware configuration for atmega328. Generated by gen_devices.py. */
#define FLASH_SIZE 32768
#define EEPROM_SIZE 1024
#define FLASH_PAGE_BYTES 128
#define SIG0 0x1e
#define SIG1 0x95
#define SIG2 0x14
#define SRAM_END 0x8ff
#define MINI_UART_STYLE 0
#define MINI_LEGACY_STACK 0
#define MINI_VIRTUAL_BOOT 0
#define MINI_FLASH_ERASE_GROUP_BYTES 128
#define MINI_WIDE_BRANCHES 0
#define MINI_SPM512_CAPABLE 1
#define MINI_SOFT_UART 0
#define MINI_WDT_CCP_STYLE 0
#define MINI_WDT_CCP_ADDR 0
#define MCUSR_IO 0x34
#define MINI_SPM_EXT 0
#define MINI_FLASH_BANKED 0
#define MINI_FLASH_128K 0
#define MINI_FLASH_256K 0
#define SPMCSR_IO 0x37
#define MINI_DEVICE_SIGROW_CAPABLE 1  /* Datasheet: SIGRD|SPMEN + LPM Z=0,2,4 */
#define SPMCSR_MEM 0x57
#define WDT_IO 0x21
#define EEPROM_EECR_IO 0x1f
#define EEPROM_EEDR_IO 0x20
#define EEPROM_EEARL_IO 0x21
#define EEPROM_EEARH_IO 0x22
#ifndef BOOT_BYTES
#define BOOT_BYTES 512
#endif
#define BOOT_START (FLASH_SIZE - BOOT_BYTES)
